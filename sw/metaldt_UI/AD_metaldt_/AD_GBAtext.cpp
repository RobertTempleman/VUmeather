#include "AD_metaldt_UI.h"
#include <avr/pgmspace.h>

// 4=lower like tail of y
// 8=dont remove space if no_space is set
// 16=dont alternate colours if no_space is set
PROGMEM const prog_uchar colour_index[96]={
  0  , 0  , 0+16, 0  , 0+8, 0  , 0+8, 0  ,
  0  , 0  , 0   , 0  , 0  , 0  , 0  , 0  ,
  2  , 2  , 2   , 2  , 2  , 2  , 2  , 2  ,
  2  , 2  , 0   , 0  , 0  , 0  , 0  , 0  ,
  0  , 1  , 1   , 1  , 1  , 1  , 1  , 1  ,
  1  , 1  , 1   , 1  , 1  , 1  , 1  , 1  ,
  1  , 1  , 1   , 1  , 1  , 1  , 1  , 1  ,
  1  , 1  , 1   , 0  , 0  , 0  , 0  , 1  ,
  0+8, 1  , 1   , 1+8, 1  , 1  , 1  , 1+4,
  1  , 1  , 1+4 , 1  , 1  , 1  , 1  , 1  ,
  1+4, 1+4, 1   , 1  , 1  , 1  , 1  , 1  ,
  1  , 1+4, 1   , 0  , 0  , 0  , 0  , 0  
};


PROGMEM prog_uchar debugfont[1440]={
  0 , 0 , 0 ,  0 ,255, 0 ,  0 , 0 , 0 ,  0 , 0 , 0 ,  0 , 0 , 0 , 255, 0 ,255,  0 , 0 , 0 ,255,255,255,  // [ ] [!] ["] [#]  [&] [%] ['] [$] 
  0 , 0 , 0 ,  0 ,255, 0 ,  0 , 0 , 0 ,  0 , 0 , 0 ,  0 , 0 , 0 ,  0 , 0 ,255, 255, 0 ,255,255 , 0 , 0 ,
  0 , 0 , 0 ,  0 ,255, 0 , 255,255,255, 255, 0 , 0 , 255, 0 ,255,  0 ,255, 0 , 255, 0 ,255,255 ,255,255,
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  255, 0 ,255,  0 ,255,255, 255,255,255,  0 ,255,255,  0 ,255, 0 , 255,255, 0 ,  0 , 0 , 0 , 255,255,255, 
};


#define FONT_CHAR_WIDTH 3
#define FONT_CHAR_HEIGHT 5
#define CHARS_PER_LINE 8
#define POW_CHARS_PER_LINE 3
#define FONT_LINE_WIDTH (CHARS_PER_LINE*FONT_CHAR_WIDTH)



void print_pretty_byte(u8 screen_x,u8 screen_y,const char *string, COLORREF colour_alpha, COLORREF colour_number, COLORREF colour_operators,bool auto_kern,bool no_output,bool no_space,bool masked){
  do{
    const u8 c=*string-32;
    const u8 fontx=c&(CHARS_PER_LINE-1);
    const u8 fonty=c>>POW_CHARS_PER_LINE;
    u16 offset_base=fontx*FONT_CHAR_WIDTH+fonty*FONT_LINE_WIDTH*FONT_CHAR_HEIGHT;
    u16 offset=offset_base;
    //    const u8 *debugfontp_base=debugfont+;
    //    const u8 *debugfontp=debugfontp_base;
    u8 index=pgm_read_byte_near(colour_index+c);
    COLORREF colour;
    if ((index&3)==1){
      colour=colour_alpha;
    }else if ((index&3)==2){
      colour=colour_number;
    }else{
      colour=colour_operators;
    }
    u8 screen_y_use=screen_y;
    if (index&4){
      screen_y_use++;
    }
    bool empty_last_column=true;
    if (auto_kern){
      bool empty_first_column=true;
      for(u8 y=0;y<FONT_CHAR_HEIGHT;y++){
        u8 ys=y+screen_y_use;
        if (pgm_read_byte_near(debugfont+offset)!=0){
          empty_first_column=false;
        }
        if (pgm_read_byte_near(debugfont+offset+2)!=0){
          empty_last_column=false;
        }
        offset+=FONT_LINE_WIDTH;
      }
      if (empty_first_column){
        screen_x-=1;
      }
    }
    for(u8 y=0;y<FONT_CHAR_HEIGHT;y++){
      u8 ys=y+screen_y_use;
      if (!no_output){
        u8 c=pgm_read_byte_near(debugfont+offset_base);
        if (masked){
          if (c) pc(screen_x+1,ys,colour);
        }else{
          pc(screen_x+1,ys,c?colour:0);
        }
        c=pgm_read_byte_near(debugfont+offset_base+1);;
        if (masked){
          if (c) pc(screen_x+2,ys,colour);
        }else{
          pc(screen_x+2,ys,c?colour:0);
        }
        c=pgm_read_byte_near(debugfont+offset_base+2);;
        if (masked){
          if (c) pc(screen_x+3,ys,colour);
        }else{
          pc(screen_x+3,ys,c?colour:0);
        }
      }
      offset_base+=FONT_LINE_WIDTH;
    }
    if (no_space){
      screen_x+=3;
      if (index&8){
        // dont remove space if index has 8 set
        screen_x++;
      }
      if (!(index&16)){
        COLORREF temp=colour_number;
        colour_number=colour_operators;
        colour_operators=temp;
      }
    }else{
      if (auto_kern && empty_last_column){
        screen_x+=3;
      }else{
        screen_x+=4;
      }
    }
  }while(*++string!=0);
}
