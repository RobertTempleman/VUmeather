// metaldt_UI.cpp : Defines the entry point for the application.
//

#include "stdafx.h"
#include "metaldt_UI.h"
#include "GBAtext.h"
#include "RTTcolours.h"
#include <stdio.h>
#include <math.h>

// plot extra graphs under windows to verify that ATMEGA memory optimisations are valid
#define WINDOWS_DEBUG_DISPLAY 1

#define MAX_LOADSTRING 100

// Global Variables:
HINSTANCE hInst;								// current instance
TCHAR szTitle[MAX_LOADSTRING];					// The title bar text
TCHAR szWindowClass[MAX_LOADSTRING];			// the main window class name

void drawit();
void draw_background();
void one_second_update_counter();

u8 pgm_read_byte_near(const u8 *add){
  return *add;
}


#define eigen 2

int base_offx=300;
int offx=base_offx;
int offy=150;
HDC ghdc;
DWORD gcol;
void win_pc(u8 _x,u8 _y,DWORD col){
  int x=(int)_x;
  int y=(int)_y;
  x*=eigen;
  y*=eigen;
  x+=offx;
  y+=offy;
//  SetPixelV(ghdc,x,y,col);
  for(int i=0;i<eigen;i++){
    for(int j=0;j<eigen;j++){
      SetPixelV(ghdc,x+i,y+j,col);
    }
  }
}



void win_drawit(HDC hdc){
  ghdc=hdc;
  HPEN stock_dc_pen=CreatePen(PS_SOLID, 1, green6_cr);
  HGDIOBJ old_pen=SelectObject(hdc,stock_dc_pen);
  HBRUSH stock_dc_brush=CreateSolidBrush(0);
  HGDIOBJ old=SelectObject(hdc,stock_dc_brush);
  static int once=1;
  if (once){
    once=0;
    Rectangle(hdc,0,0,1600,1000);
    draw_background();
  }
  drawit();
  SelectObject(hdc,old_pen);
  SelectObject(hdc,old);
  DeleteObject(stock_dc_brush);
  DeleteObject(stock_dc_pen);
}



// Forward declarations of functions included in this code module:
ATOM				MyRegisterClass(HINSTANCE hInstance);
BOOL				InitInstance(HINSTANCE, int);
LRESULT CALLBACK	WndProc(HWND, UINT, WPARAM, LPARAM);
INT_PTR CALLBACK	About(HWND, UINT, WPARAM, LPARAM);

int APIENTRY _tWinMain(_In_ HINSTANCE hInstance,
                     _In_opt_ HINSTANCE hPrevInstance,
                     _In_ LPTSTR    lpCmdLine,
                     _In_ int       nCmdShow)
{
	UNREFERENCED_PARAMETER(hPrevInstance);
	UNREFERENCED_PARAMETER(lpCmdLine);

 	// TODO: Place code here.
	MSG msg;
	HACCEL hAccelTable;

	// Initialize global strings
	LoadString(hInstance, IDS_APP_TITLE, szTitle, MAX_LOADSTRING);
	LoadString(hInstance, IDC_metaldt_UI, szWindowClass, MAX_LOADSTRING);
	MyRegisterClass(hInstance);

	// Perform application initialization:
	if (!InitInstance (hInstance, nCmdShow))
	{
		return FALSE;
	}

	hAccelTable = LoadAccelerators(hInstance, MAKEINTRESOURCE(IDC_metaldt_UI));

	// Main message loop:
	while (GetMessage(&msg, NULL, 0, 0))
	{
		if (!TranslateAccelerator(msg.hwnd, hAccelTable, &msg))
		{
			TranslateMessage(&msg);
			DispatchMessage(&msg);
		}
	}

	return (int) msg.wParam;
}



//
//  FUNCTION: MyRegisterClass()
//
//  PURPOSE: Registers the window class.
//
ATOM MyRegisterClass(HINSTANCE hInstance)
{
	WNDCLASSEX wcex;

	wcex.cbSize = sizeof(WNDCLASSEX);

	wcex.style			= CS_HREDRAW | CS_VREDRAW;
	wcex.lpfnWndProc	= WndProc;
	wcex.cbClsExtra		= 0;
	wcex.cbWndExtra		= 0;
	wcex.hInstance		= hInstance;
	wcex.hIcon			= LoadIcon(hInstance, MAKEINTRESOURCE(IDI_metaldt_UI));
	wcex.hCursor		= LoadCursor(NULL, IDC_ARROW);
	wcex.hbrBackground	= (HBRUSH)(COLOR_WINDOW+1);
	wcex.lpszMenuName	= MAKEINTRESOURCE(IDC_metaldt_UI);
	wcex.lpszClassName	= szWindowClass;
	wcex.hIconSm		= LoadIcon(wcex.hInstance, MAKEINTRESOURCE(IDI_SMALL));

	return RegisterClassEx(&wcex);
}








////////////////////////////////////////////////////////////////////////////////////////////////////////////////////////////////////////////////////////////////
////////////////////////////////////////////////////////////////////////////////////////////////////////////////////////////////////////////////////////////////
////////////////////////////////////////////////////////////////////////////////////////////////////////////////////////////////////////////////////////////////
////////////////////////////////////////////////////////////////////////////////////////////////////////////////////////////////////////////////////////////////
#define NUM_SBM20S 4
#define NUM_TUBES (NUM_SBM20S+1)

float scale[NUM_TUBES]={1.f,15.f,300.f,2000.1f};
float da[NUM_TUBES]={0.1f,0.23f,2.f,1.11f};
int counts[NUM_TUBES];
DWORD start_ticks;

////////////////////////////////////////////////////////////////////////////////////////////////////////////////////////////////////////////////////////////////
////////////////////////////////////////////////////////////////////////////////////////////////////////////////////////////////////////////////////////////////
////////////////////////////////////////////////////////////////////////////////////////////////////////////////////////////////////////////////////////////////

//
//   FUNCTION: InitInstance(HINSTANCE, int)
//
//   PURPOSE: Saves instance handle and creates main window
//
//   COMMENTS:
//
//        In this function, we save the instance handle in a global variable and
//        create and display the main program window.
//
BOOL InitInstance(HINSTANCE hInstance, int nCmdShow)
{
   HWND hWnd;
   start_ticks=GetTickCount();
   hInst = hInstance; // Store instance handle in our global variable

   hWnd = CreateWindow(szWindowClass, szTitle, WS_OVERLAPPEDWINDOW,
      CW_USEDEFAULT, 0, CW_USEDEFAULT, 0, NULL, NULL, hInstance, NULL);

   if (!hWnd)
   {
      return FALSE;
   }

   ShowWindow(hWnd, nCmdShow);
   UpdateWindow(hWnd);
   for(int i=1;i<5;i++){
     SetTimer(hWnd,i,10,0);
   }

   SetTimer(hWnd,10,500,0);
   SetTimer(hWnd,5,100,0);

   return TRUE;
}

//
//  FUNCTION: WndProc(HWND, UINT, WPARAM, LPARAM)
//
//  PURPOSE:  Processes messages for the main window.
//
//  WM_COMMAND	- process the application menu
//  WM_PAINT	- Paint the main window
//  WM_DESTROY	- post a quit message and return
//
//
LRESULT CALLBACK WndProc(HWND hWnd, UINT message, WPARAM wParam, LPARAM lParam)
{
	int wmId, wmEvent;
	PAINTSTRUCT ps;
	HDC hdc;
  static float a=0;

	switch (message)
	{
	case WM_COMMAND:
		wmId    = LOWORD(wParam);
		wmEvent = HIWORD(wParam);
		// Parse the menu selections:
		switch (wmId)
		{
		case IDM_ABOUT:
			DialogBox(hInst, MAKEINTRESOURCE(IDD_ABOUTBOX), hWnd, About);
			break;
		case IDM_EXIT:
			DestroyWindow(hWnd);
			break;
		default:
			return DefWindowProc(hWnd, message, wParam, lParam);
		}
		break;
	case WM_PAINT:
		hdc = BeginPaint(hWnd, &ps);
		// TODO: Add any drawing code here...
    win_drawit(hdc);
		EndPaint(hWnd, &ps);
		break;
  case WM_TIMER:
    switch(wParam){
      case 1:
        counts[wParam-1]+=1+(int)fabsf((150.0f*(1.1f+sinf(a)+cosf(a*3.21f)+1.1f*sinf(a*1.123243f)*cosf(.2132132f*a))));
        a+=0.004f;
        break;
      case 2:
        counts[wParam-1]+=1+(int)fabsf((2.0f*(1.1f+sinf(a)+cosf(a*1.21f)+1.4f*sinf(a*1.123243f)*cosf(.2132132f*a))));
        a+=0.005f;
        break;
      case 3:
        if (((rand()*1000)/RAND_MAX)<100){
          counts[wParam-1]+=1+(int)fabsf((1.0f*(1.1f+sinf(a)+cosf(a*2.21f)+2.0f*sinf(a*1.123243f)*cosf(.2132132f*a))));
        }
        a+=0.003f;
        break;
      case 4:
        if (((rand()*1000)/RAND_MAX)<3){
          counts[wParam-1]++;
        }
        break;
      case 10:
        InvalidateRect(hWnd,0,FALSE);
        break;
      case 5:
        {
          one_second_update_counter();
        }
        break;
    }
    break;
	case WM_DESTROY:
		PostQuitMessage(0);
		break;
	default:
		return DefWindowProc(hWnd, message, wParam, lParam);
	}
	return 0;
}

// Message handler for about box.
INT_PTR CALLBACK About(HWND hDlg, UINT message, WPARAM wParam, LPARAM lParam)
{
	UNREFERENCED_PARAMETER(lParam);
	switch (message)
	{
	case WM_INITDIALOG:
		return (INT_PTR)TRUE;

	case WM_COMMAND:
		if (LOWORD(wParam) == IDOK || LOWORD(wParam) == IDCANCEL)
		{
			EndDialog(hDlg, LOWORD(wParam));
			return (INT_PTR)TRUE;
		}
		break;
	}
	return (INT_PTR)FALSE;
}


void pc(u8 x,u8 y,DWORD col){
  win_pc(x,y,col);
}



///////////////////////////////////////////////////////////////////////////////////////////////////////////////////////////////////////////////////////////////////////////////////////////////////////////////////////////////////////////////////////////////////////////////////////////////
///////////////////////////////////////////////////////////////////////////////////////////////////////////////////////////////////////////////////////////////////////////////////////////////////////////////////////////////////////////////////////////////////////////////////////////////
///////////////////////////////////////////////////////////////////////////////////////////////////////////////////////////////////////////////////////////////////////////////////////////////////////////////////////////////////////////////////////////////////////////////////////////////
///////////////////////////////////////////////////////////////////////////////////////////////////////////////////////////////////////////////////////////////////////////////////////////////////////////////////////////////////////////////////////////////////////////////////////////////
///////////////////////////////////////////////////////////////////////////////////////////////////////////////////////////////////////////////////////////////////////////////////////////////////////////////////////////////////////////////////////////////////////////////////////////////
///////////////////////////////////////////////////////////////////////////////////////////////////////////////////////////////////////////////////////////////////////////////////////////////////////////////////////////////////////////////////////////////////////////////////////////////
///////////////////////////////////////////////////////////////////////////////////////////////////////////////////////////////////////////////////////////////////////////////////////////////////////////////////////////////////////////////////////////////////////////////////////////////
///////////////////////////////////////////////////////////////////////////////////////////////////////////////////////////////////////////////////////////////////////////////////////////////////////////////////////////////////////////////////////////////////////////////////////////////
///////////////////////////////////////////////////////////////////////////////////////////////////////////////////////////////////////////////////////////////////////////////////////////////////////////////////////////////////////////////////////////////////////////////////////////////
///////////////////////////////////////////////////////////////////////////////////////////////////////////////////////////////////////////////////////////////////////////////////////////////////////////////////////////////////////////////////////////////////////////////////////////////
///////////////////////////////////////////////////////////////////////////////////////////////////////////////////////////////////////////////////////////////////////////////////////////////////////////////////////////////////////////////////////////////////////////////////////////////
///////////////////////////////////////////////////////////////////////////////////////////////////////////////////////////////////////////////////////////////////////////////////////////////////////////////////////////////////////////////////////////////////////////////////////////////
///////////////////////////////////////////////////////////////////////////////////////////////////////////////////////////////////////////////////////////////////////////////////////////////////////////////////////////////////////////////////////////////////////////////////////////////
///////////////////////////////////////////////////////////////////////////////////////////////////////////////////////////////////////////////////////////////////////////////////////////////////////////////////////////////////////////////////////////////////////////////////////////////
///////////////////////////////////////////////////////////////////////////////////////////////////////////////////////////////////////////////////////////////////////////////////////////////////////////////////////////////////////////////////////////////////////////////////////////////
///////////////////////////////////////////////////////////////////////////////////////////////////////////////////////////////////////////////////////////////////////////////////////////////////////////////////////////////////////////////////////////////////////////////////////////////
///////////////////////////////////////////////////////////////////////////////////////////////////////////////////////////////////////////////////////////////////////////////////////////////////////////////////////////////////////////////////////////////////////////////////////////////





#define NUM_HISTORIES 60

float microsieverts[NUM_SBM20S]={0,0,0,0};

float counts_smoothed_1s[NUM_TUBES]={0,0,0,0,0};
u32 counts_last_min[NUM_TUBES]={0,0,0,0,0};
u32 counts_last_min_byte[NUM_TUBES]={0,0,0,0,0};

u32 counts_per_sec[NUM_TUBES]={0,0,0,0,0};
u32 counts_per_min[NUM_TUBES]={0,0,0,0,0};

#if WINDOWS_DEBUG_DISPLAY==1
  int history_counts_per_sec[NUM_TUBES][NUM_HISTORIES];
  int history_counts_per_min[NUM_TUBES][NUM_HISTORIES];
#endif

u8 byte_history_counts_per_sec[NUM_TUBES][NUM_HISTORIES];  // normalized history graph data (normalized so maximum value in history=255)
u8 byte_history_counts_per_min[NUM_TUBES][NUM_HISTORIES];

u32 byte_history_counts_per_sec_peak_value[NUM_TUBES]={1,1,1,1,1};  // history graph peak value stored
u32 byte_history_counts_per_min_peak_value[NUM_TUBES]={1,1,1,1,1};  

float metaldt__tube_HV=406.3f;
float battery_voltage=4.25f;

#define LINE_HEIGHT 6
#define CPM_TO_MICROSIEVERTS 175.43f



#define LOWER_TUBES_PLOT_Y 98

// main uSv/h display
#define TOTAL_MICROSIEVERTS_PER_HOUR_READING_PLOT_X 12
#define TOTAL_MICROSIEVERTS_PER_HOUR_READING_PLOT_Y 62

#define TUBE_VOLTAGE_PLOT_X 10
#define TUBE_VOLTAGE_PLOT_Y 155

#define BATTERY_VOLTAGE_PLOT_X 70
#define BATTERY_VOLTAGE_PLOT_Y 155

#define metaldt__BATTERY_COL_TEXT grey40_cr
#define metaldt__BATTERY_COL_NUMBERS green4_cr
#define metaldt__BATTERY_SYMBOLS coral4_cr




////////////////////////////////////////////////////////////////////
////////////////// total info display /////////////////////////////
////////////////////////////////////////////////////////////////////
// counts last second graph
#define TOTAL_GRAPH_SECONDS_X 68
#define TOTAL_GRAPH_SECONDS_Y 95   // bottom of the graph
#define TOTAL_GRAPH_SECONDS_W 59
#define TOTAL_GRAPH_SECONDS_H 15

// counts last minute graph
#define TOTAL_GRAPH_MINUTES_X 2
#define TOTAL_GRAPH_MINUTES_Y 95   // bottom of the graph
#define TOTAL_GRAPH_MINUTES_W 59
#define TOTAL_GRAPH_MINUTES_H 15

#define TOTAL_SEC_GRAPH_COL_LINES      white_cr
#define TOTAL_SEC_GRAPH_COL_BACKGROUND grey10_cr
#define TOTAL_SEC_GRAPH_COL_TEXT       goldenrod_cr
#define TOTAL_MIN_GRAPH_COL_LINES      steelblue3_cr
#define TOTAL_MIN_GRAPH_COL_BACKGROUND darkblue_cr
#define TOTAL_MIN_GRAPH_COL_TEXT       goldenrod2_cr


////////////////////////////////////////////////////////////////////
/////////////// per metaldt_ tube info display ///////////////////////
////////////////////////////////////////////////////////////////////
// activity bar indicator
#define MICROSIEVERTS_FOR_FULL_BAR_HEIGHT 1.0f
#define CURRENT_COUNT_BAR_X 49
#define CURRENT_COUNT_BAR_Y 24 // bottom of bar
#define CURRENT_COUNT_BAR_W 13
#define CURRENT_COUNT_BAR_H 22

// counts last second graph
#define GRAPH_SECONDS_X 3
#define GRAPH_SECONDS_Y 41   // bottom of the graph
#define GRAPH_SECONDS_W 59
#define GRAPH_SECONDS_H 15

// counts last minute graph
#define GRAPH_MINUTES_X 3
#define GRAPH_MINUTES_Y 54   // bottom of the graph
#define GRAPH_MINUTES_W 59
#define GRAPH_MINUTES_H 11



void p(u8 x, u8 y){
  win_pc(x,y,gcol);
}

void hline(u8 x,u8 y,u8 w){
  for(u8 i=x;i<=x+w;i++){
    p(i,y);
  }
}

void vline(u8 x,u8 y,u8 h){
  for(u8 i=y-h;i<=y;i++){
    p(x,i);
  }
}

void rectfill(u8 x,u8 y,u8 w,u8 h){
  for(u8 i=x;i<=x+w;i++){
    vline(i,y,h);
  }
}

void rect(u8 x,u8 y,u8 w,u8 h){
  hline(x  ,y  ,w);
  hline(x  ,y+h,w);
  vline(x  ,y+h-1,h-2);
  vline(x+w,y+h-1,h-2);
}



void draw_graph_axis(u8 graph_x,u8 graph_y,u8 graph_h){
  u8 x=graph_x-2;
  hline(x,graph_y,2);
  hline(x,graph_y-graph_h,2);
  hline(x,graph_y-(graph_h>>1),2);
  vline(x+1,graph_y,graph_h);
}



void draw_tube_background(u8 orig_x,u8 orig_y,u8 wx,u8 wy,u8 tube){
  gcol=grey80_cr;
  rect(orig_x,orig_y,wx-1,wy-9);
  u8 y=orig_y+2;
  u8 xtext=orig_x+1;
  print_pretty_byte(xtext,y,"c/S",grey65_cr,coral2_cr,green3_cr,false,false,true);y+=LINE_HEIGHT;
  print_pretty_byte(xtext,y,"c/\"#",grey65_cr,coral2_cr,green3_cr,false,false,true);y+=LINE_HEIGHT;
  print_pretty_byte(xtext,y,"&'$/h",grey65_cr,coral2_cr,green3_cr,false,false,true);y+=LINE_HEIGHT;
  print_pretty_byte(xtext,y,"&'$/h",grey65_cr,coral2_cr,green3_cr,false,false,true);y+=LINE_HEIGHT;
  gcol=lightblue4_cr;
  draw_graph_axis(orig_x+GRAPH_SECONDS_X,orig_y+GRAPH_SECONDS_Y,GRAPH_SECONDS_H);
  draw_graph_axis(orig_x+GRAPH_MINUTES_X,orig_y+GRAPH_MINUTES_Y,GRAPH_MINUTES_H);
}



void plot_numbert_float(u8 orig_x,u8 &y,float n,COLORREF col2,bool int_if_less_than_1000=false){
  char rtt[10];
  if (n<1000.0f){
    if (int_if_less_than_1000){
      sprintf(rtt,"%6d ",(u32)n);
    }else{
      if (n<1.0f)
        sprintf(rtt,"%6.3f ",n);
      if (n<10.0f){
        sprintf(rtt,"%6.2f ",n);
      }else if (n<100.0f){
        sprintf(rtt,"%6.1f ",n);
      }else if (n<1000.f){
        sprintf(rtt,"%6.0f ",n);
      }
    }
  }else{
    n*=0.001f;
    if (n<1.0f)
      sprintf(rtt,"%6.3fk",n);
    if (n<10.0f){
      sprintf(rtt,"%6.2fk",n);
    }else if (n<100.0f){
      sprintf(rtt,"%6.1fk",n);
    }else if (n<1000.f){
      sprintf(rtt,"%6.0fk",n);
    }else{
      sprintf(rtt,"%6.3fM",n*0.001f);
    }
  }
  print_pretty_byte(orig_x+20,y,rtt,grey65_cr,col2,green3_cr);y+=LINE_HEIGHT;
}



void vline_clipped_for_graph(u8 x,u8 y,u8 h,u8 graph_top_y,u8 clip_w){
  // clip the graph drawing around the axis value
  bool draw=true;
  if (x<clip_w){
    if (y<=graph_top_y){
      draw=false;
    }else{
      u8 clip_y=graph_top_y+6;
      if (y-h<clip_y){
        h=y-clip_y;
      }
    }
  }
  if (draw){
    vline(x,y,h);
  }
}



void do_a_graph(u8 graph_x,u8 graph_y,u8 graph_w,u8 graph_h,u8 *values,COLORREF col_lines,COLORREF col_background,COLORREF col_text){
  u8 max_val=1;
  for(u8 i=0;i<NUM_HISTORIES;i++){
    u8 c=values[i];
    if (c>max_val){
      max_val=c;
    }
  }
  // draw text first to ger everything
  u8 clip_w;
  char *format;
  if (max_val<10){
    format="%1d";
    clip_w=1;
  }else if (max_val<100){
    format="%2d";
    clip_w=2;
  }else if (max_val<1000){
    format="%3d";
    clip_w=3;
  }else if (max_val<10000){
    format="%4d";
    clip_w=4;
  }else if (max_val<100000){
    format="%5d";
    clip_w=5;
  }else if (max_val<1000000){
    format="%6d";
    clip_w=6;
  }else{
    format="%7d";
    clip_w=7;
  }
  clip_w=clip_w*4+graph_x+2;
  char rtt[16];
  sprintf(rtt,format,max_val);
  print_pretty_byte(graph_x+1,graph_y-graph_h,rtt,col_text,col_text,col_text);

  for(u8 i=0;i<=graph_w;i++){
    u8 h=(graph_h*values[graph_w-i])/max_val;
    u8 x=graph_x+i;
    gcol=col_lines;
    if (h){
      vline_clipped_for_graph(x,graph_y,h,graph_y-graph_h,clip_w);
    }
    gcol=col_background;
    if (h<=graph_h){
      if (graph_h-h){
        u8 extra_background=h?1:0;
        vline_clipped_for_graph(x,graph_y-h-extra_background,graph_h-h-extra_background,graph_y-graph_h,clip_w);
      }
    }
  }
}



#if WINDOWS_DEBUG_DISPLAY==1
void do_a_graph_PC(int graph_x,int graph_y,int graph_w,int graph_h,int *values,COLORREF col_lines,COLORREF col_background,COLORREF col_text){
  int max_val=1;
  for(int i=0;i<NUM_HISTORIES;i++){
    int c=values[i];
    if (c>max_val){
      max_val=c;
    }
  }
  // draw text first to ger everything
  int clip_w;
  char *format;
  if (max_val<10){
    format="%1d";
    clip_w=1;
  }else if (max_val<100){
    format="%2d";
    clip_w=2;
  }else if (max_val<1000){
    format="%3d";
    clip_w=3;
  }else if (max_val<10000){
    format="%4d";
    clip_w=4;
  }else if (max_val<100000){
    format="%5d";
    clip_w=5;
  }else if (max_val<1000000){
    format="%6d";
    clip_w=6;
  }else{
    format="%7d";
    clip_w=7;
  }
  clip_w=clip_w*4+graph_x+2;
  char rtt[16];
  sprintf(rtt,format,max_val);
  print_pretty_byte((u8)(graph_x+1),(u8)(graph_y-graph_h),rtt,col_text,col_text,col_text);

  for(int i=0;i<=graph_w;i++){
    int h=(graph_h*values[graph_w-i])/max_val;
    int x=graph_x+i;
    gcol=col_lines;
    if (h){
      vline_clipped_for_graph(x,graph_y,h,graph_y-graph_h,clip_w);
    }
    gcol=col_background;
    if (h<=graph_h){
      if (graph_h-h){
        int extra_background=h?1:0;
        vline_clipped_for_graph(x,graph_y-h-extra_background,graph_h-h-extra_background,graph_y-graph_h,clip_w);
      }
    }
  }
}
#endif



void do_a_byte_graph(u8 graph_x,u8 graph_y,u8 graph_w,u8 graph_h,u8 *values,int peak_value,COLORREF col_lines,COLORREF col_background,COLORREF col_text){
  // draw text first to ger everything
  u8 clip_w;
  char *format;
  if (peak_value<10){
    format="%1d";
    clip_w=1;
  }else if (peak_value<100){
    format="%2d";
    clip_w=2;
  }else if (peak_value<1000){
    format="%3d";
    clip_w=3;
  }else if (peak_value<10000){
    format="%4d";
    clip_w=4;
  }else if (peak_value<100000){
    format="%5d";
    clip_w=5;
  }else if (peak_value<1000000){
    format="%6d";
    clip_w=6;
  }else{
    format="%7d";
    clip_w=7;
  }
  clip_w=clip_w*4+graph_x+2;
  char rtt[16];
  sprintf(rtt,format,peak_value);
  print_pretty_byte(graph_x+1,graph_y-graph_h,rtt,col_text,col_text,col_text);

  for(u8 i=0;i<=graph_w;i++){
    u8 h=(graph_h*values[graph_w-i])/255;
    u8 x=graph_x+i;
    gcol=col_lines;
    if (h){
      vline_clipped_for_graph(x,graph_y,h,graph_y-graph_h,clip_w);
    }
    gcol=col_background;
    if (h<=graph_h){
      if (graph_h-h){
        u8 extra_background=h?1:0;
        vline_clipped_for_graph(x,graph_y-h-extra_background,graph_h-h-extra_background,graph_y-graph_h,clip_w);
      }
    }
  }
}



void draw_tube(u8 orig_x,u8 orig_y,u8 wx,u8 wy,u8 tube){
  char rtt[16];
  u8 y=orig_y+2;
  int cps=counts_per_sec[tube];
  if (cps==0){
    plot_numbert_float(orig_x,y,counts_smoothed_1s[tube],lightblue_cr);
  }else{
    sprintf(rtt,"%6d",cps);
    print_pretty_byte(orig_x+20,y,rtt,grey65_cr,lightblue_cr,green3_cr);y+=LINE_HEIGHT;
  }
  plot_numbert_float(orig_x,y,(float)counts_last_min[tube],white_cr,true);
#if WINDOWS_DEBUG_DISPLAY==1
  offx=base_offx+160*eigen;
  plot_numbert_float(orig_x,y,(float)counts_last_min_byte[tube],white_cr,true);y-=LINE_HEIGHT;
  offx=base_offx;
#endif
  float us_10s_timeperiod=counts_smoothed_1s[tube]*60.0f/CPM_TO_MICROSIEVERTS;
  microsieverts[tube]=us_10s_timeperiod;
  plot_numbert_float(orig_x,y,us_10s_timeperiod,coral2_cr);
  float us=(float)counts_last_min[tube]/CPM_TO_MICROSIEVERTS;
  plot_numbert_float(orig_x,y,us,coral2_cr);


  int bar_h=(int)(us*CURRENT_COUNT_BAR_H/(float)MICROSIEVERTS_FOR_FULL_BAR_HEIGHT);
  gcol=green5_cr;
  if (bar_h>CURRENT_COUNT_BAR_H){
    bar_h/=CURRENT_COUNT_BAR_H;
    gcol=grey40_cr;
  }
  if (bar_h>CURRENT_COUNT_BAR_H){
    bar_h/=CURRENT_COUNT_BAR_H;
    gcol=orange3_cr;
  }
  if (bar_h>CURRENT_COUNT_BAR_H){
    bar_h/=CURRENT_COUNT_BAR_H;
    gcol=red_cr;
  }
  if (bar_h>CURRENT_COUNT_BAR_H){
    bar_h/=CURRENT_COUNT_BAR_H;
    gcol=white_cr;
  }
  u8 x=orig_x+CURRENT_COUNT_BAR_X;
  y=orig_y+CURRENT_COUNT_BAR_Y;
  rectfill(x,y,CURRENT_COUNT_BAR_W,bar_h);
  if (bar_h<=CURRENT_COUNT_BAR_H){
    gcol=grey15_cr;
    rectfill(x,y-bar_h-1,CURRENT_COUNT_BAR_W,CURRENT_COUNT_BAR_H-bar_h);
  }

#if WINDOWS_DEBUG_DISPLAY==1
  offx=base_offx+160*eigen;
  do_a_graph_PC(orig_x+GRAPH_SECONDS_X,orig_y+GRAPH_SECONDS_Y,GRAPH_SECONDS_W,GRAPH_SECONDS_H,history_counts_per_sec[tube],white_cr,grey10_cr,goldenrod_cr);
  do_a_graph_PC(orig_x+GRAPH_MINUTES_X,orig_y+GRAPH_MINUTES_Y,GRAPH_MINUTES_W,GRAPH_MINUTES_H,history_counts_per_min[tube],steelblue3_cr,darkblue_cr,goldenrod2_cr);
  offx=base_offx;
#endif
  do_a_byte_graph(orig_x+GRAPH_SECONDS_X,orig_y+GRAPH_SECONDS_Y,GRAPH_SECONDS_W,GRAPH_SECONDS_H,byte_history_counts_per_sec[tube],byte_history_counts_per_sec_peak_value[tube],white_cr,grey10_cr,goldenrod_cr);
  do_a_byte_graph(orig_x+GRAPH_MINUTES_X,orig_y+GRAPH_MINUTES_Y,GRAPH_MINUTES_W,GRAPH_MINUTES_H,byte_history_counts_per_min[tube],byte_history_counts_per_min_peak_value[tube],steelblue3_cr,darkblue_cr,goldenrod2_cr);
}



#if WINDOWS_DEBUG_DISPLAY==1
// return sum of history array
int update_history(int val,int* history,int num){
  int t=0;
  for(int i=num-1;i>0;i--){
    int h=history[i-1];
    history[i]=h;
    t+=h;
  }
  history[0]=val;
  return t;
}
#endif


void renormalize_array(u8* history,u8 num,u8 peak){
  for(u8 i=0;i<num;i++){
    u16 v=(u16)history[i];
    history[i]=(u8)(v*255/peak);
  }
}




int update_history2(u32 val,u8* history,u32 &peak_value,u8 num){
  // get total thats stored
  u8 peak=0;
  // get peak value & shuffle history over
  int total=history[0];
  for(u8 i=num-1;i>0;i--){
    u8 h=history[i-1];
    if (h>peak){
      peak=h;
    }
    history[i]=h;
    total+=h;
  }
  total=(total*peak_value)/255;
  if (peak!=0 && peak<255){
    // renormalize graph data after scroll
    u8 new_peak=0;
    for(u8 i=0;i<num;i++){
      u8 v=history[i];
      if (v>new_peak){
        new_peak=v;
      }
      history[i]=(u8)(((u16)v*255)/(u16)peak);
    }
    peak_value=((u32)new_peak*peak_value)/255;
  }
  if (val>peak_value){
    // renormalize graph data to accomodate higher peak
    for(u8 i=0;i<num;i++){
      u32 v=(u32)history[i];
      history[i]=(u8)((v*peak_value+(val>>1))/val);
    }
    peak_value=val;
    history[0]=255;
  }else{
    history[0]=(u8)((255*val)/peak_value);
  }
  return total;
}

#define SMOOTHING_TIME_PERIOD 10
#define EMA_ALPHA (2.0f/(SMOOTHING_TIME_PERIOD+1))


void one_second_update_counter(){
  static short counter_min=60;
  // 1s timer
  int t=0;
  // add up counts from last second
  for(u8 i=0;i<NUM_SBM20S;i++){
    int c=counts[i];
    counts[i]=0;
    counts_per_sec[i]=c;
    counts_per_min[i]+=c;
    t+=c;
  }
  counts_per_sec[NUM_SBM20S]=t;
  counts_per_min[NUM_SBM20S]+=t;

  for(u8 i=0;i<NUM_TUBES;i++){
    int c=counts_per_sec[i];
#if WINDOWS_DEBUG_DISPLAY==1
    counts_last_min[i]=update_history(c,history_counts_per_sec[i],NUM_HISTORIES);
#endif
    counts_last_min_byte[i]=update_history2(c,byte_history_counts_per_sec[i],byte_history_counts_per_sec_peak_value[i],NUM_HISTORIES);
    counts_smoothed_1s[i]=(1.0f-EMA_ALPHA)*(float)counts_smoothed_1s[i]+EMA_ALPHA*(float)c;
  }

  counter_min--;
  if (counter_min==0){
    counter_min=60;
    for(u8 i=0;i<NUM_TUBES;i++){
      int c=counts_per_min[i];
      counts_per_min[i]=0;
#if WINDOWS_DEBUG_DISPLAY==1
      update_history(c,history_counts_per_min[i],NUM_HISTORIES);
#endif
      update_history2(c,byte_history_counts_per_min[i],byte_history_counts_per_min_peak_value[i],NUM_HISTORIES);

    }
  }
}




// bookman_oldstyle chars 0123456789uSvph
#define CHAR_IMAGE_WIDTH 13
#define CHAR_PLOT_WIDTH 10
#define CHAR_PLOT_HEIGHT 13
#define CHAR_IMAGE_STRIDE 182
PROGMEM prog_uchar big_font[]={
  0x00,0x00,0x10,0x58,0x86,0x72,0x26,0x00,0x00,0x00,0x00,0x00,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0x36
  ,0x00,0x00,0x00,0x00,0x00,0x00,0x00,0x00,0x1c,0x67,0x86,0x78,0x36,0x00,0x00,0x00,0x00,0x00,0x00,0x00,0x00,0x00,0x00,0x00,0x0a,0x47,0x14,0x00,0x00,0x00,0x00,0x00
  ,0x00,0x0f,0x67,0x50,0x30,0x24,0x35,0x67,0x16,0x00,0x00,0x00,0x00,0x00,0x00,0x00,0x1a,0x64,0x86,0x6d,0x21,0x00,0x00,0x00,0x00,0x00,0x00,0x37,0x6b,0x51,0x4f,0x4f
  ,0x4f,0x51,0x41,0x03,0x00,0x00,0x00,0x00,0x00,0x0a,0x54,0x84,0x81,0x4a,0x02,0x00,0x00,0x00,0x00,0x00,0x00,0x00,0x15,0x5e,0x86,0x72,0x28,0x00,0x00,0x00,0x00,0x00
  ,0x00,0x00,0x00,0x00,0x00,0x00,0x00,0x00,0x00,0x00,0x00,0x00,0x00,0x00,0x00,0x00,0x00,0x00,0x00,0x00,0x00,0x00,0x00,0x00,0x00,0x00,0x00,0x00,0x00,0x00,0x00,0x00
  ,0x00,0x00,0x00,0x00,0x00,0x00,0x00,0x00,0x00,0x00,0x00,0x00,0x00,0x00,0x00,0x00,0x00,0x00,0x00,0x00,0x00,0x00,0x14,0xa6,0xe6,0xa0,0xc6,0xda,0x42,0x00,0x00,0x00
  ,0x00,0x00,0x00,0x1d,0x52,0x80,0xcc,0xc9,0x11,0x00,0x00,0x00,0x00,0x00,0x00,0x00,0x33,0xc9,0xc3,0xa5,0xd2,0xea,0x73,0x02,0x00,0x00,0x00,0x00,0x00,0x2a,0xc1,0xbf
  ,0x9b,0xc7,0xe9,0x63,0x00,0x00,0x00,0x00,0x00,0x00,0x00,0x00,0x00,0x00,0x6c,0xe6,0x2a,0x00,0x00,0x00,0x00,0x00,0x00,0x16,0xe3,0xf6,0xe5,0xe2,0xf3,0xbf,0x13,0x00
  ,0x00,0x00,0x00,0x00,0x00,0x39,0xce,0xd4,0x9c,0xd9,0xcc,0x2d,0x00,0x00,0x00,0x00,0x00,0x82,0xff,0xf9,0xf8,0xf8,0xf5,0xf5,0xa8,0x05,0x00,0x00,0x00,0x00,0x16,0xa5
  ,0xd3,0x95,0xa4,0xe8,0x95,0x0f,0x00,0x00,0x00,0x00,0x00,0x22,0xbb,0xe4,0x9f,0xc6,0xdf,0x4b,0x00,0x00,0x00,0x00,0x00,0x00,0x00,0x00,0x00,0x00,0x00,0x00,0x00,0x00
  ,0x00,0x00,0x00,0x00,0x00,0x00,0x00,0x00,0x00,0x00,0x00,0x00,0x00,0x00,0x00,0x00,0x00,0x00,0x00,0x00,0x00,0x00,0x00,0x00,0x00,0x00,0x00,0x00,0x00,0x00,0x00,0x00
  ,0x00,0x00,0x00,0x00,0x00,0x00,0x00,0x00,0x00,0x00,0x00,0x00,0x78,0xfb,0x58,0x00,0x1b,0xd0,0xd3,0x1d,0x00,0x00,0x00,0x00,0x00,0x4d,0xce,0xd7,0xef,0xc4,0x11,0x00
  ,0x00,0x00,0x00,0x00,0x00,0x0e,0xbc,0x91,0x05,0x00,0x1d,0xca,0xed,0x3b,0x00,0x00,0x00,0x00,0x00,0x8a,0xf3,0x3b,0x00,0x1a,0xd1,0xe1,0x26,0x00,0x00,0x00,0x00,0x00
  ,0x00,0x00,0x00,0x32,0xe3,0xe1,0x28,0x00,0x00,0x00,0x00,0x00,0x00,0x1f,0xd3,0xb2,0xc0,0xc1,0x91,0x24,0x00,0x00,0x00,0x00,0x00,0x00,0x21,0xd4,0xd0,0x21,0x00,0xc7
  ,0xff,0x75,0x00,0x00,0x00,0x00,0x00,0xa0,0xc9,0x71,0x70,0x70,0x83,0xe7,0x49,0x00,0x00,0x00,0x00,0x00,0x75,0xe9,0x2b,0x00,0x00,0x6e,0xf7,0x4e,0x00,0x00,0x00,0x00
  ,0x0a,0xa5,0xf6,0x51,0x00,0x16,0xbf,0xde,0x25,0x00,0x00,0x00,0x00,0x00,0x00,0x00,0x00,0x00,0x00,0x00,0x00,0x00,0x00,0x00,0x00,0x00,0x00,0x00,0x00,0x00,0x00,0x00
  ,0x00,0x00,0x00,0x00,0x00,0x00,0x00,0x00,0x00,0x00,0x00,0x00,0x00,0x00,0x00,0x00,0x00,0x00,0x00,0x00,0x00,0x00,0x00,0x00,0x00,0x00,0x00,0x00,0x00,0x00,0x00,0x00
  ,0x00,0x16,0xd2,0xd5,0x14,0x00,0x00,0x80,0xff,0x62,0x00,0x00,0x00,0x00,0x00,0x09,0x12,0x1c,0xd1,0xc9,0x11,0x00,0x00,0x00,0x00,0x00,0x00,0x21,0xe3,0xb5,0x33,0x00
  ,0x00,0x93,0xfd,0x67,0x00,0x00,0x00,0x00,0x00,0x9a,0xff,0x87,0x00,0x00,0xa3,0xf3,0x46,0x00,0x00,0x00,0x00,0x00,0x00,0x00,0x0e,0xb4,0xf3,0xdb,0x27,0x00,0x00,0x00
  ,0x00,0x00,0x00,0x2d,0xc2,0x0e,0x00,0x00,0x00,0x00,0x00,0x00,0x00,0x00,0x00,0x00,0x79,0xfd,0x62,0x00,0x07,0xab,0xe1,0x47,0x00,0x00,0x00,0x00,0x0e,0xc9,0x66,0x00
  ,0x00,0x00,0x71,0xb4,0x05,0x00,0x00,0x00,0x00,0x00,0xaa,0xd3,0x02,0x00,0x00,0x38,0xf3,0x6a,0x00,0x00,0x00,0x00,0x2f,0xe7,0xcf,0x12,0x00,0x00,0x65,0xfe,0x6a,0x00
  ,0x00,0x00,0x00,0x00,0x00,0x00,0x00,0x00,0x00,0x00,0x00,0x00,0x00,0x00,0x00,0x00,0x00,0x00,0x00,0x1d,0x23,0x00,0x00,0x00,0x00,0x00,0x00,0x00,0x00,0x00,0x00,0x00
  ,0x00,0x00,0x00,0x00,0x00,0x00,0x00,0x00,0x00,0x00,0x00,0x00,0x00,0x00,0x00,0x00,0x00,0x00,0x00,0x00,0x00,0x00,0x00,0x3d,0xed,0xb3,0x05,0x00,0x00,0x5c,0xfb,0x95
  ,0x00,0x00,0x00,0x00,0x00,0x00,0x00,0x0c,0xca,0xc9,0x11,0x00,0x00,0x00,0x00,0x00,0x00,0x19,0xd5,0xff,0x8e,0x00,0x00,0xb4,0xf8,0x5d,0x00,0x00,0x00,0x00,0x00,0x3c
  ,0x9b,0x37,0x00,0x00,0xb4,0xed,0x30,0x00,0x00,0x00,0x00,0x00,0x00,0x00,0x7c,0xcd,0xbf,0xe1,0x27,0x00,0x00,0x00,0x00,0x00,0x00,0x3b,0xba,0x44,0x5e,0x4f,0x1e,0x00
  ,0x00,0x00,0x00,0x00,0x00,0x11,0xc7,0xe2,0x1c,0x00,0x11,0x13,0x17,0x00,0x00,0x00,0x00,0x00,0x14,0xae,0x31,0x00,0x00,0x20,0xda,0x53,0x00,0x00,0x00,0x00,0x00,0x00
  ,0x9c,0xf6,0x8c,0x25,0x02,0x78,0xea,0x36,0x00,0x00,0x00,0x00,0x49,0xee,0xbe,0x08,0x00,0x00,0x51,0xf8,0x98,0x00,0x00,0x00,0x00,0x00,0x2a,0x00,0x00,0x2a,0x00,0x00
  ,0x00,0x00,0x00,0x00,0x00,0x00,0x00,0x24,0xa7,0x99,0x91,0xb7,0x56,0x00,0x00,0x00,0x00,0x00,0x00,0x00,0x00,0x00,0x00,0x00,0x00,0x00,0x00,0x00,0x00,0x00,0x00,0x00
  ,0x00,0x00,0x31,0x56,0x00,0x00,0x00,0x00,0x00,0x00,0x00,0x00,0x00,0x59,0xf6,0xa2,0x00,0x00,0x00,0x4d,0xf2,0xb0,0x05,0x00,0x00,0x00,0x00,0x00,0x00,0x11,0xcb,0xc9
  ,0x11,0x00,0x00,0x00,0x00,0x00,0x00,0x00,0x58,0xac,0x3f,0x00,0x41,0xee,0xda,0x26,0x00,0x00,0x00,0x00,0x00,0x00,0x00,0x38,0x46,0x79,0xe2,0x73,0x02,0x00,0x00,0x00
  ,0x00,0x00,0x00,0x44,0xe4,0x45,0xa4,0xe4,0x28,0x00,0x00,0x00,0x00,0x00,0x00,0x4b,0xe8,0xd5,0xc9,0xea,0xd6,0x52,0x00,0x00,0x00,0x00,0x00,0x2f,0xe6,0xc6,0x56,0xb6
  ,0xd1,0xac,0x44,0x00,0x00,0x00,0x00,0x00,0x03,0x10,0x00,0x00,0x00,0x74,0xd1,0x12,0x00,0x00,0x00,0x00,0x00,0x00,0x49,0xe2,0xf1,0xd3,0xab,0xe3,0x60,0x00,0x00,0x00
  ,0x00,0x00,0x3d,0xea,0xd7,0x1a,0x00,0x00,0x79,0xf9,0xac,0x03,0x00,0x00,0x00,0x18,0xbd,0x15,0x00,0xbc,0x28,0x00,0x00,0x00,0x00,0x00,0x00,0x00,0x00,0xb3,0x72,0x00
  ,0x00,0x63,0x72,0x00,0x00,0x00,0x00,0x00,0x00,0x00,0x00,0x00,0x00,0x00,0x00,0x00,0x00,0x00,0x00,0x00,0x00,0x00,0x00,0x00,0x87,0x9a,0x9a,0x23,0x00,0x00,0x00,0x00
  ,0x00,0x00,0x00,0x62,0xf9,0x9c,0x00,0x00,0x00,0x47,0xee,0xb7,0x0c,0x00,0x00,0x00,0x00,0x00,0x00,0x12,0xcb,0xca,0x11,0x00,0x00,0x00,0x00,0x00,0x00,0x00,0x00,0x00
  ,0x00,0x19,0xc2,0xf4,0x5c,0x00,0x00,0x00,0x00,0x00,0x00,0x00,0x20,0xc8,0xcc,0xe1,0xdd,0x45,0x00,0x00,0x00,0x00,0x00,0x00,0x1d,0xd2,0x7c,0x00,0xb0,0xe5,0x28,0x00
  ,0x00,0x00,0x00,0x00,0x00,0xa5,0xc2,0x25,0x11,0x45,0xe1,0xe6,0x39,0x00,0x00,0x00,0x00,0x44,0xe7,0xe1,0xda,0x87,0x7c,0xe1,0xeb,0x47,0x00,0x00,0x00,0x00,0x00,0x00
  ,0x00,0x00,0x14,0xd2,0x8a,0x00,0x00,0x00,0x00,0x00,0x00,0x00,0x00,0x7d,0xf5,0xf3,0xf6,0xea,0xa6,0x21,0x00,0x00,0x00,0x00,0x14,0xc0,0xf8,0x91,0x2e,0x54,0xdd,0xf0
  ,0xad,0x05,0x00,0x00,0x00,0x18,0xb9,0x15,0x00,0xb8,0x27,0x00,0x00,0x00,0x00,0x00,0x00,0x00,0x15,0xc8,0x44,0x00,0x00,0x00,0x12,0x00,0x00,0x00,0x00,0x00,0x00,0x00
  ,0x00,0x00,0x00,0x00,0x00,0x00,0x00,0x00,0x00,0x00,0x00,0x00,0x00,0x15,0x93,0x17,0xb8,0x20,0x00,0x00,0x00,0x00,0x00,0x00,0x00,0x5e,0xf9,0xa0,0x00,0x00,0x00,0x49
  ,0xf0,0xb4,0x07,0x00,0x00,0x00,0x00,0x00,0x00,0x12,0xcb,0xc9,0x11,0x00,0x00,0x00,0x00,0x00,0x00,0x00,0x00,0x00,0x0a,0xa3,0xf8,0x6b,0x00,0x00,0x00,0x00,0x00,0x00
  ,0x00,0x00,0x00,0x12,0x14,0x25,0xc4,0xe7,0x3a,0x00,0x00,0x00,0x00,0x05,0x96,0xb3,0x00,0x00,0xad,0xe4,0x1c,0x00,0x00,0x00,0x00,0x00,0x00,0x58,0x3e,0x00,0x00,0x00
  ,0x8d,0xff,0x86,0x00,0x00,0x00,0x00,0x45,0xe6,0xee,0x64,0x00,0x00,0x6b,0xfc,0xa9,0x05,0x00,0x00,0x00,0x00,0x00,0x00,0x00,0x52,0xf3,0x52,0x00,0x00,0x00,0x00,0x00
  ,0x00,0x00,0x59,0xdd,0x98,0x61,0xa9,0xe7,0xfa,0x91,0x02,0x00,0x00,0x00,0x00,0x38,0xc8,0xf4,0xe6,0xd8,0xac,0xea,0xa3,0x00,0x00,0x00,0x00,0x1b,0xb8,0x12,0x00,0xb6
  ,0x25,0x00,0x00,0x00,0x00,0x00,0x00,0x00,0x00,0xba,0xba,0x69,0x4a,0x27,0x00,0x00,0x00,0x00,0x00,0x00,0x00,0x5c,0x5b,0x26,0x49,0x60,0x0b,0x00,0x00,0x00,0x00,0x00
  ,0x00,0x00,0x00,0x5f,0x55,0x00,0xa8,0x7c,0x7f,0x2b,0x00,0x00,0x00,0x00,0x00,0x4c,0xf1,0xac,0x02,0x00,0x00,0x54,0xf7,0xa0,0x00,0x00,0x00,0x00,0x00,0x00,0x00,0x11
  ,0xcb,0xc9,0x11,0x00,0x00,0x00,0x00,0x00,0x00,0x00,0x00,0x00,0x90,0xeb,0x59,0x00,0x2b,0x2f,0x00,0x00,0x00,0x00,0x07,0x71,0x99,0x1e,0x00,0x00,0x73,0xff,0x8e,0x00
  ,0x00,0x00,0x00,0x47,0xf8,0xa7,0x7f,0x81,0xcd,0xe3,0x92,0x73,0x0e,0x00,0x00,0x00,0x05,0x6e,0xa0,0x27,0x00,0x00,0x6b,0xfe,0x9b,0x00,0x00,0x00,0x00,0x36,0xe5,0xdb
  ,0x1f,0x00,0x00,0x36,0xe8,0xc6,0x11,0x00,0x00,0x00,0x00,0x00,0x00,0x02,0xa5,0xea,0x2e,0x00,0x00,0x00,0x00,0x00,0x00,0x22,0xe2,0xae,0x02,0x00,0x02,0x49,0xda,0xd0
  ,0x12,0x00,0x00,0x00,0x00,0x00,0x13,0x49,0x59,0x29,0x50,0xfa,0x85,0x00,0x00,0x00,0x00,0x23,0xc0,0x1b,0x18,0xc0,0x2e,0x00,0x00,0x00,0x00,0x00,0x00,0x00,0x00,0x33
  ,0x99,0xba,0xc4,0xcd,0x8b,0x00,0x00,0x00,0x00,0x00,0x00,0x9c,0xc8,0x19,0x87,0xaa,0x00,0x00,0x00,0x00,0x00,0x00,0x00,0x00,0x00,0x96,0x00,0x00,0xb2,0x79,0x74,0xaf
  ,0x00,0x00,0x00,0x00,0x00,0x25,0xe1,0xc9,0x0f,0x00,0x00,0x6f,0xff,0x75,0x00,0x00,0x00,0x00,0x00,0x00,0x00,0x11,0xcb,0xc9,0x11,0x00,0x00,0x00,0x00,0x00,0x00,0x00
  ,0x00,0x76,0xcc,0x35,0x00,0x00,0xa3,0x7f,0x00,0x00,0x00,0x00,0x26,0xe5,0xfe,0x58,0x00,0x00,0x65,0xfd,0xa0,0x00,0x00,0x00,0x00,0x3e,0xa0,0xa3,0xaa,0xaa,0xd6,0xe3
  ,0xb6,0x98,0x10,0x00,0x00,0x00,0x1e,0xe0,0xfe,0x5f,0x00,0x00,0x76,0xff,0x90,0x00,0x00,0x00,0x00,0x17,0xd2,0xdf,0x1c,0x00,0x00,0x33,0xea,0xbb,0x0a,0x00,0x00,0x00
  ,0x00,0x00,0x00,0x26,0xdf,0xdb,0x1a,0x00,0x00,0x00,0x00,0x00,0x00,0x42,0xf7,0x6e,0x00,0x00,0x00,0x00,0x95,0xda,0x14,0x00,0x00,0x00,0x00,0x4a,0x94,0x29,0x00,0x00
  ,0x81,0xfc,0x50,0x00,0x00,0x00,0x00,0x34,0xc9,0xa6,0xa1,0xc5,0x93,0x00,0x00,0x00,0x00,0x00,0x00,0x00,0x00,0x00,0x00,0x00,0x04,0x72,0xca,0x19,0x00,0x00,0x00,0x00
  ,0x00,0x21,0xbe,0x1e,0x85,0x2c,0x00,0x00,0x00,0x00,0x00,0x00,0x00,0x00,0x45,0x80,0x00,0x00,0xae,0x13,0x00,0xb0,0x00,0x00,0x00,0x00,0x00,0x03,0x9e,0xf4,0x39,0x00
  ,0x00,0xb0,0xe8,0x2d,0x00,0x00,0x00,0x00,0x00,0x00,0x00,0x00,0xcc,0xc8,0x00,0x00,0x00,0x00,0x00,0x00,0x00,0x00,0x55,0xeb,0x81,0x3f,0x40,0x52,0xe1,0x69,0x00,0x00
  ,0x00,0x00,0x22,0xe5,0xb9,0x18,0x00,0x00,0x8b,0xff,0x7b,0x00,0x00,0x00,0x00,0x00,0x00,0x00,0x00,0x00,0xaf,0xe6,0x1b,0x00,0x00,0x00,0x00,0x00,0x19,0xde,0xbb,0x1a
  ,0x00,0x00,0xb3,0xf9,0x53,0x00,0x00,0x00,0x00,0x00,0x84,0xf9,0x4f,0x00,0x00,0x60,0xfe,0x7c,0x00,0x00,0x00,0x00,0x00,0x00,0x00,0x52,0xf0,0xce,0x13,0x00,0x00,0x00
  ,0x00,0x00,0x00,0x2a,0xec,0xa0,0x00,0x00,0x00,0x0f,0xc7,0xa1,0x03,0x00,0x00,0x00,0x07,0xbb,0xff,0x7a,0x00,0x1c,0xd8,0xc5,0x14,0x00,0x00,0x00,0x00,0x58,0xa1,0x4d
  ,0x1a,0x29,0x16,0x00,0x00,0x00,0x00,0x00,0x00,0x00,0x00,0x73,0x00,0x00,0x00,0x35,0xc6,0x07,0x00,0x00,0x00,0x00,0x00,0x00,0x96,0xa9,0x8d,0x00,0x00,0x00,0x00,0x00
  ,0x00,0x00,0x00,0x00,0x34,0x1c,0x00,0x00,0xb4,0x1e,0x14,0xb3,0x00,0x00,0x00,0x00,0x00,0x00,0x2c,0xd9,0xc9,0x50,0x7f,0xf2,0x6d,0x00,0x00,0x00,0x00,0x00,0x00,0x18
  ,0x76,0x8a,0xec,0xe7,0x85,0x78,0x23,0x00,0x00,0x00,0x00,0x3b,0xeb,0xf6,0xf1,0xf3,0xf0,0xf5,0xfb,0x5c,0x00,0x00,0x00,0x00,0x05,0x95,0xce,0x58,0x42,0x72,0xed,0xc3
  ,0x22,0x00,0x00,0x00,0x00,0x00,0x00,0x00,0x34,0x85,0xdf,0xf2,0x9d,0x45,0x00,0x00,0x00,0x00,0x00,0x81,0xd4,0x5f,0x4d,0x9a,0xf9,0x93,0x09,0x00,0x00,0x00,0x00,0x00
  ,0x22,0xcd,0xd8,0x57,0x5b,0xe0,0xbf,0x1c,0x00,0x00,0x00,0x00,0x00,0x00,0x00,0x62,0xfe,0xc6,0x10,0x00,0x00,0x00,0x00,0x00,0x00,0x03,0x82,0xf5,0x92,0x4d,0x58,0xb4
  ,0xd7,0x2f,0x00,0x00,0x00,0x00,0x02,0x96,0xfe,0x85,0x51,0xbd,0xe3,0x3e,0x00,0x00,0x00,0x00,0x00,0x66,0x8d,0x00,0x00,0x00,0x00,0x00,0x00,0x00,0x00,0x00,0x00,0x00
  ,0x00,0xbd,0x48,0x11,0x29,0xa9,0x6d,0x00,0x00,0x00,0x00,0x00,0x00,0x00,0x42,0xd7,0x4b,0x00,0x00,0x00,0x00,0x00,0x00,0x00,0x00,0x00,0x00,0x00,0x00,0x4c,0xb8,0x77
  ,0x22,0xb2,0x4c,0x00,0x00,0x00,0x00,0x00,0x00,0x2f,0x9e,0xc2,0xb7,0x5c,0x00,0x00,0x00,0x00,0x00,0x00,0x00,0x1c,0x98,0x9f,0x90,0x90,0x9f,0x9d,0x2b,0x00,0x00,0x00
  ,0x00,0x44,0x99,0x8f,0x90,0x91,0x91,0x91,0x91,0x33,0x00,0x00,0x00,0x00,0x00,0x11,0x72,0xb4,0xbd,0xbd,0x81,0x20,0x00,0x00,0x00,0x00,0x00,0x00,0x00,0x00,0x44,0xa4
  ,0x92,0x8f,0xa5,0x59,0x00,0x00,0x00,0x00,0x00,0x0a,0x6c,0xba,0xc1,0xb3,0x63,0x0c,0x00,0x00,0x00,0x00,0x00,0x00,0x00,0x28,0x94,0xc0,0xbf,0x8c,0x20,0x00,0x00,0x00
  ,0x00,0x00,0x00,0x00,0x00,0x30,0xbc,0x78,0x02,0x00,0x00,0x00,0x00,0x00,0x00,0x00,0x08,0x60,0xb1,0xc0,0xbd,0x96,0x2d,0x00,0x00,0x00,0x00,0x00,0x00,0x1e,0x8a,0xbc
  ,0xbf,0x9a,0x31,0x00,0x00,0x00,0x00,0x00,0x00,0x00,0x0d,0x00,0x00,0x00,0x00,0x00,0x00,0x00,0x00,0x00,0x00,0x00,0x00,0x63,0x9b,0x9a,0x90,0x4e,0x00,0x00,0x00,0x00
  ,0x00,0x00,0x00,0x00,0x00,0x61,0x00,0x00,0x00,0x00,0x00,0x00,0x00,0x00,0x00,0x00,0x00,0x00,0x00,0x00,0x00,0x00,0x00,0x00,0x00,0x00,0x00,0x00,0x00};



void plot_big_char(u8 xp,u8 yp,u8 chr,u8 char_plot_width=CHAR_PLOT_WIDTH){ 
  u8 xo=chr*CHAR_IMAGE_WIDTH;
  for(u8 y=0;y<CHAR_PLOT_HEIGHT;y++){
    for(u8 x=0;x<char_plot_width;x++){
      u32 c=(u32)pgm_read_byte_near(big_font+xo+x+y*CHAR_IMAGE_STRIDE);
      c=c+(c<<8)+(c<<16);
      gcol=c; 
      p(x+xp,y+yp);
    }
  }
}




#define US_READING_uSv_PLOT_X (TOTAL_MICROSIEVERTS_PER_HOUR_READING_PLOT_X+75)

void drawit(){
  draw_tube(0  ,0  ,64,64,0);
  draw_tube(64 ,0  ,64,64,1);
  draw_tube(0  ,LOWER_TUBES_PLOT_Y ,64,64,2);
  draw_tube(64 ,LOWER_TUBES_PLOT_Y ,64,64,3);
  // plot main averaged reading number in big font
  float mean_us=0;
  for(u8 i=0;i<NUM_SBM20S;i++){
    mean_us+=microsieverts[i];
  }
  mean_us*=(1.0f/NUM_SBM20S);
  char rtt[16];
  sprintf(rtt,"%8.3f",mean_us);
  u8 xp=TOTAL_MICROSIEVERTS_PER_HOUR_READING_PLOT_X;
  for(u8 i=0;i<8;i++){
    u8 c=rtt[i];
    if (c=='.'){
      u8 x=TOTAL_MICROSIEVERTS_PER_HOUR_READING_PLOT_X+i*10+1;
      u8 y=TOTAL_MICROSIEVERTS_PER_HOUR_READING_PLOT_Y+11;
      gcol=white_cr;
      p(x,y);
      p(x+1,y);
      p(x,y+1);
      p(x+1,y+1);
      xp+=5;
    }else{
      if (c!=' '){
        plot_big_char(xp,TOTAL_MICROSIEVERTS_PER_HOUR_READING_PLOT_Y,rtt[i]-'0');
      }
      xp+=CHAR_PLOT_WIDTH;
    }
  }
  sprintf(rtt,"%5.1fV",metaldt__tube_HV);
  print_pretty_byte(TUBE_VOLTAGE_PLOT_X+25,TUBE_VOLTAGE_PLOT_Y,rtt,metaldt__BATTERY_COL_TEXT,metaldt__BATTERY_COL_NUMBERS,metaldt__BATTERY_COL_NUMBERS,true,false,false);
  sprintf(rtt,"%5.3fV",battery_voltage);
  print_pretty_byte(BATTERY_VOLTAGE_PLOT_X+31,BATTERY_VOLTAGE_PLOT_Y,rtt,metaldt__BATTERY_COL_TEXT,metaldt__BATTERY_COL_NUMBERS,metaldt__BATTERY_COL_NUMBERS,true,false,false);
#if WINDOWS_DEBUG_DISPLAY==1
  offx=base_offx+160*eigen;
  do_a_graph_PC(TOTAL_GRAPH_SECONDS_X,TOTAL_GRAPH_SECONDS_Y,TOTAL_GRAPH_SECONDS_W,TOTAL_GRAPH_SECONDS_H,history_counts_per_sec[NUM_SBM20S],TOTAL_SEC_GRAPH_COL_LINES,TOTAL_SEC_GRAPH_COL_BACKGROUND,TOTAL_SEC_GRAPH_COL_TEXT);
  do_a_graph_PC(TOTAL_GRAPH_MINUTES_X,TOTAL_GRAPH_MINUTES_Y,TOTAL_GRAPH_MINUTES_W,TOTAL_GRAPH_MINUTES_H,history_counts_per_min[NUM_SBM20S],TOTAL_MIN_GRAPH_COL_LINES,TOTAL_MIN_GRAPH_COL_BACKGROUND,TOTAL_MIN_GRAPH_COL_TEXT);
  offx=base_offx;
#endif
  do_a_byte_graph(TOTAL_GRAPH_SECONDS_X,TOTAL_GRAPH_SECONDS_Y,TOTAL_GRAPH_SECONDS_W,TOTAL_GRAPH_SECONDS_H,byte_history_counts_per_sec[NUM_SBM20S],byte_history_counts_per_sec_peak_value[NUM_SBM20S],TOTAL_SEC_GRAPH_COL_LINES,TOTAL_SEC_GRAPH_COL_BACKGROUND,TOTAL_SEC_GRAPH_COL_TEXT);
  do_a_byte_graph(TOTAL_GRAPH_MINUTES_X,TOTAL_GRAPH_MINUTES_Y,TOTAL_GRAPH_MINUTES_W,TOTAL_GRAPH_MINUTES_H,byte_history_counts_per_min[NUM_SBM20S],byte_history_counts_per_min_peak_value[NUM_SBM20S],TOTAL_MIN_GRAPH_COL_LINES,TOTAL_MIN_GRAPH_COL_BACKGROUND,TOTAL_MIN_GRAPH_COL_TEXT);
}


void draw_background(){
  draw_tube_background(0  ,0  ,64,64,0);
  draw_tube_background(64 ,0  ,64,64,1);
  draw_tube_background(0  ,LOWER_TUBES_PLOT_Y ,64,64,2);
  draw_tube_background(64 ,LOWER_TUBES_PLOT_Y ,64,64,3);
  plot_big_char(US_READING_uSv_PLOT_X+4,TOTAL_MICROSIEVERTS_PER_HOUR_READING_PLOT_Y+1,10);
  plot_big_char(US_READING_uSv_PLOT_X+CHAR_PLOT_WIDTH,TOTAL_MICROSIEVERTS_PER_HOUR_READING_PLOT_Y-2,11);
  plot_big_char(US_READING_uSv_PLOT_X+CHAR_PLOT_WIDTH*2-2,TOTAL_MICROSIEVERTS_PER_HOUR_READING_PLOT_Y,12);
  plot_big_char(US_READING_uSv_PLOT_X+CHAR_PLOT_WIDTH*3-7,TOTAL_MICROSIEVERTS_PER_HOUR_READING_PLOT_Y+1,13,13);

  print_pretty_byte(TUBE_VOLTAGE_PLOT_X,TUBE_VOLTAGE_PLOT_Y,"metaldt_=",metaldt__BATTERY_COL_TEXT,metaldt__BATTERY_COL_NUMBERS,metaldt__BATTERY_SYMBOLS,true,false,false);
  print_pretty_byte(BATTERY_VOLTAGE_PLOT_X,BATTERY_VOLTAGE_PLOT_Y,"Battery=",metaldt__BATTERY_COL_TEXT,metaldt__BATTERY_COL_NUMBERS,metaldt__BATTERY_SYMBOLS,true,false,false);
  gcol=lightblue4_cr;
  draw_graph_axis(TOTAL_GRAPH_SECONDS_X,TOTAL_GRAPH_SECONDS_Y,TOTAL_GRAPH_SECONDS_H);
  draw_graph_axis(TOTAL_GRAPH_MINUTES_X,TOTAL_GRAPH_MINUTES_Y,TOTAL_GRAPH_MINUTES_H);
}


